## firmware/bridge-board/components/uplink_wifi/Kconfig
```kconfig
menu "Bridge upstream Wi-Fi"
config GW_UPLINK_SSID
    string "Upstream SSID (2.4 GHz Wi-Fi)"
    default ""
config GW_UPLINK_OWE
    bool "Use Enhanced Open / OWE (no passphrase)"
    depends on ESP_WIFI_ENABLE_WPA3_OWE_STA
    default n
    help
        Select for passwordless Enhanced Open networks. Leave the upstream
        passphrase empty.
        Only OWE associations are accepted; unencrypted Open, personal and
        enterprise authentication are not accepted in this mode.
        When disabled, WPA2/WPA3 personal and a passphrase are required.
config GW_UPLINK_PASSWORD
    string "Upstream WPA2/WPA3 passphrase (empty for OWE; private sdkconfig)"
    default ""
endmenu
```

## firmware/bridge-board/sdkconfig.defaults
```kconfig
CONFIG_IDF_TARGET="esp32s3"
CONFIG_ESPTOOLPY_FLASHSIZE_4MB=y
CONFIG_PARTITION_TABLE_SINGLE_APP_LARGE=y
CONFIG_FREERTOS_HZ=1000
CONFIG_LWIP_IP_FORWARD=y
CONFIG_LWIP_IPV4_NAPT=y
CONFIG_LWIP_IPV4_NAPT_PORTMAP=n
CONFIG_LWIP_IPV6=n
CONFIG_LWIP_TCPIP_TASK_STACK_SIZE=8192
CONFIG_ESP_WIFI_SOFTAP_SUPPORT=n
CONFIG_ESP_WIFI_ENABLE_WPA3_SAE=y
CONFIG_LOG_DEFAULT_LEVEL_INFO=y
```

## firmware/common/board_led/Kconfig
```kconfig
menu "Board identity LED"
config GW_BOARD_RGB_LED
    bool "Enable onboard addressable RGB LED"
    default y if IDF_TARGET_ESP32C6
    default n
    help
        C6-WROOM-1 DevKitC-1 boards use an addressable RGB LED on GPIO8.
        Station shows blue and bridge red. This identifies the firmware
        role, not Wi-Fi or forwarding readiness. Disable for boards without
        this LED, or change its GPIO to match your board.
config GW_BOARD_RGB_GPIO
    int "Addressable RGB LED GPIO"
    depends on GW_BOARD_RGB_LED
    range 0 48
    default 8
endmenu
```

## firmware/common/gateway_link/Kconfig
```kconfig
menu "Gateway board link"
config GW_LINK_UART
    bool "Use two-wire UART instead of SPI"
    default n
    help
        Enable on both boards for a slower UART test link with TX, RX and
        common ground. SPI remains the default for the Rev A PCB.
config GW_LINK_DIAGNOSTICS
    bool "Log packet counters and run a one-time HTTP connectivity check"
    default n
    help
        Troubleshooting only. Counts packets without logging their contents.
        Requests http://example.com once after forwarding becomes ready.
config GW_UART_TX_GPIO
    int "UART TX GPIO"
    depends on GW_LINK_UART
    range 0 48
    default 6
config GW_UART_RX_GPIO
    int "UART RX GPIO"
    depends on GW_LINK_UART
    range 0 48
    default 7
config GW_UART_BAUD
    int "UART link baud rate"
    depends on GW_LINK_UART
    range 115200 1000000
    default 921600
config GW_SPI_CONTROLLER
    bool "Build Board A endpoint (SPI controller / UART host)"
    default n
config GW_BRIDGE_IP
    string "Board B SPI IPv4 address"
    default "192.168.77.1"
config GW_HOST_IP
    string "Board A SPI IPv4 address"
    default "192.168.77.2"
config GW_LINK_MASK
    string "SPI network mask (must be /30)"
    default "255.255.255.252"
config GW_SPI_CLOCK_HZ
    int "Controller SPI clock (Hz)"
    range 100000 10000000
    default 4000000
config GW_SPI_SCLK_GPIO
    int "SPI clock GPIO"
    range 0 48
    default 6 if IDF_TARGET_ESP32C6
    default 12
config GW_SPI_MOSI_GPIO
    int "SPI MOSI GPIO"
    range 0 48
    default 7 if IDF_TARGET_ESP32C6
    default 11
config GW_SPI_MISO_GPIO
    int "SPI MISO GPIO"
    range 0 48
    default 2 if IDF_TARGET_ESP32C6
    default 13
config GW_SPI_CS_GPIO
    int "SPI chip-select GPIO"
    range 0 48
    default 18 if IDF_TARGET_ESP32C6
    default 10
config GW_SPI_HS_GPIO
    int "SPI handshake GPIO"
    range 0 48
    default 19 if IDF_TARGET_ESP32C6
    default 4
    help
        Match the wiring at both endpoints. ESP32-C6 defaults avoid its USB
        pins (GPIO12/13), flash pins and strapping pins. The S3 defaults match
        the Rev A PCB. See hardware/docs/README.md for both pinouts.
endmenu
```

## firmware/spi-test-host/main/Kconfig.projbuild
```kconfig
menu "SPI host network tests"
config GW_TEST_DNS_NAME
    string "DNS lookup name"
    default "example.com"
config GW_TEST_HTTPS_URL
    string "HTTPS test URL (must use https://)"
    default "https://example.com/"
config GW_TEST_NTP_SERVER
    string "NTP server for certificate validity checks"
    default "pool.ntp.org"
config GW_TEST_ECHO_HOST
    string "TCP/UDP echo server host (empty skips echo tests)"
    default ""
config GW_TEST_ECHO_PORT
    int "TCP/UDP echo server port"
    range 1 65535
    default 9000
config GW_TEST_INTERVAL_S
    int "Seconds between test rounds"
    range 5 3600
    default 30
endmenu
```

## firmware/spi-test-host/sdkconfig.defaults
```kconfig
CONFIG_IDF_TARGET="esp32s3"
CONFIG_ESPTOOLPY_FLASHSIZE_4MB=y
CONFIG_PARTITION_TABLE_SINGLE_APP_LARGE=y
CONFIG_GW_SPI_CONTROLLER=y
CONFIG_FREERTOS_HZ=1000
CONFIG_LWIP_IPV6=n
CONFIG_LWIP_IP_FORWARD=n
CONFIG_LWIP_TCPIP_TASK_STACK_SIZE=8192
CONFIG_MBEDTLS_CERTIFICATE_BUNDLE=y
CONFIG_MBEDTLS_CERTIFICATE_BUNDLE_DEFAULT_FULL=y
CONFIG_LOG_DEFAULT_LEVEL_INFO=y
```

## firmware/station-board/components/access_point/Kconfig
```kconfig
menu "Station board WPA2 access point"
config GW_AP_SSID
    string "Access point SSID"
    default "IoT-Gateway"
config GW_AP_PASSWORD
    string "WPA2 passphrase (8-63 bytes; never commit sdkconfig)"
    default ""
config GW_AP_IP
    string "Private AP gateway IPv4 (RFC1918, /24, ending in .1)"
    default "192.168.78.1"
    help
        Must not overlap the SPI link or Board B's upstream network.
        DHCP defaults to .100 through .199 in this /24. The UI computer's
        static address defaults to .10, outside that automatic pool.
        Both boards keep their link addresses under Gateway board link.
config GW_AP_DHCP_FIRST_HOST
    int "First automatic DHCP address (last octet)"
    range 2 253
    default 100
config GW_AP_DHCP_LAST_HOST
    int "Last automatic DHCP address (last octet)"
    range 3 254
    default 199
config GW_AP_UI_HOST
    int "UI computer static address (last octet, excluded from DHCP)"
    range 2 254
    default 10
    help
        Configure this static address on the UI computer itself. This option
        validates that the DHCP pool cannot assign that address to others;
        it is not a MAC-based DHCP reservation or an access-control identity.
config GW_AP_CHANNEL
    int "2.4 GHz channel"
    range 1 11
    default 6
config GW_AP_MAX_CLIENTS
    int "Maximum associated devices"
    range 1 10
    default 4
config GW_AP_LEASE_MINUTES
    int "DHCP lease duration (minutes)"
    range 2 1440
    default 5
endmenu
```

## firmware/target-device/main/Kconfig.projbuild
```kconfig
menu "Board C IoT device"
config TARGET_WIFI_SSID
    string "Station AP SSID (private sdkconfig only)"
    default ""
config TARGET_WIFI_PASSWORD
    string "Station AP passphrase (private sdkconfig only)"
    default ""
config TARGET_UI_HOST
    string "UI computer IPv4 address"
    default "192.168.78.10"
config TARGET_UI_PORT
    int "PC authenticated device TLS port (UI stays on 8000)"
    range 1 65535
    default 8443
config TARGET_DEVICE_ID
    string "Device ID (match PC server --device-id)"
    default "iot-c6"
config TARGET_POLL_MS
    int "Command polling interval (ms)"
    range 250 2000
    default 500
config TARGET_LED_GPIO
    int "Addressable RGB LED GPIO"
    range -1 48 if IDF_TARGET_ESP32S3
    range 0 30 if IDF_TARGET_ESP32C6
    default -1 if IDF_TARGET_ESP32S3
    default 8 if IDF_TARGET_ESP32C6
    help
        Set the verified carrier-board WS2812 pin before building for S3.
        The module memory suffix does not identify the onboard LED pin.
endmenu
```
